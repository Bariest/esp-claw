## main/Kconfig.projbuild
```kconfig
menu "App Config"

menu "Default Wi-Fi Settings"

    config APP_WIFI_SSID
        string "Default Wi-Fi SSID"
        default ""
        help
            Default Wi-Fi SSID used to populate app settings.

    config APP_WIFI_PASSWORD
        string "Default Wi-Fi password"
        default ""
        help
            Default Wi-Fi password used to populate app settings.

    config APP_WIFI_AP_SSID_PREFIX
        string "Provisioning AP SSID prefix"
        default "esp-claw"
        help
            Prefix used to build the unique provisioning AP SSID. The full
            SSID is "<prefix>-<MAC[3..5]>" (e.g. esp-claw-84AEE5).

    config APP_WIFI_AP_CHANNEL
        int "Provisioning AP channel"
        range 1 13
        default 1
        help
            Channel used by the provisioning SoftAP.

    config APP_WIFI_AP_MAX_CONN
        int "Provisioning AP max connections"
        range 1 10
        default 4
        help
            Maximum number of concurrent stations on the provisioning AP.

    config APP_WIFI_MAX_RETRY
        int "STA max retries before AP fallback"
        range 1 20
        default 5
        help
            After this many consecutive STA connection failures the device
            falls back to pure AP mode and waits for the user to provision
            new credentials.

endmenu

menu "Default Search Settings"

    config APP_SEARCH_HTTP_ALLOWLIST
        string "Default HTTP Request allowlist"
        default "*"
        help
            Default value used to populate app setting `search_http_allowlist`.
            Use `*` to allow all hosts, or a comma-separated list of domains/IPs.

            e.g. "api.example.com,*.example.org,203.0.113.10"

endmenu


menu "MP4 Robot"

    config MP4_ROBOT_ENABLE
        bool "MP4 quadruped robot support"
        depends on APP_CLAW_CAP_LUA
        depends on APP_CLAW_CAP_SKILL_MGR
        default n
        help
            Enable the MangDang quadruped robot stack for the MP4 ESP32 CORE
            board: the AT32F413 servo driver boards over SPI, the Stanford
            gait generator and inverse kinematics, the WASM skill runtime,
            and the /v1 API the MPX-Dog PWA speaks.

            Board defaults turn this on; it is off by default so that stock
            ESP-Claw boards still build from this tree.

    config MP4_ROBOT_SERVO_BOARD_VARIANT
        int "Servo driver board wiring variant"
        depends on MP4_ROBOT_ENABLE
        range 1 5
        default 1
        help
            Which physical servo wiring this robot was built with. The AT32
            driver boards are interchangeable but the legs are not always
            plugged in the same order, so a logical servo id maps to a
            different physical channel per build. See db_phys() in
            components/mpx_robot/src/driver_board.h.

            1 = normal (black board)
            2 = hip/calf swapped within each leg
            3 = purple board (leg groups swapped straight across)
            4 = white pupper, ports 3/12/9/8/6 broken
            5 = white pupper, ports 4/5/6/8 broken

    config MP4_ROBOT_UUID
        string "Robot UUID"
        depends on MP4_ROBOT_ENABLE
        default "MPX-DOG-01"
        help
            Identifies this robot to the skill marketplace gateway, and is
            the AAD for the MPXE encrypted-skill key unwrap. Changing it
            makes every already-purchased skill fail to decrypt.

    config MP4_DISPLAY_BUFFER_LINES
        int "LVGL draw buffer height, in scan lines"
        depends on ESP_BOARD_DEV_DISPLAY_LCD_SUPPORT
        range 4 240
        default 8
        help
            How many scan lines LVGL renders before handing them to the panel.

            This is a memory setting, not a speed one. With CONFIG_SPIRAM on,
            display_service picks the "SPI with PSRAM" profile, so the draw
            buffer lives in external RAM -- and SPI DMA cannot read it
            directly. spi_master therefore allocates an internal bounce
            buffer the size of each transfer, copies into it, and frees it
            again, on every flush.

            At the upstream default of 40 lines that bounce buffer is
            40 x 320 x 2 = 25600 bytes of internal DMA memory, requested and
            released several times a second. On a board where internal RAM is
            already tight it fails, and the panel fills the log with

                spi_master: setup_dma_priv_buffer(): Failed to allocate priv TX buffer
                lcd_panel.st7789: io tx color failed
                esp_lvgl:bridge_v9: Draw bitmap failed: ESP_ERR_NO_MEM

            while still showing whatever was drawn before memory ran out --
            so the screen looks fine and the log says otherwise.

            8 lines is 5120 bytes. 16 was the first attempt and was enough
            until the WebSocket client turned up and took its own internal
            buffers, at which point every flush started failing again -- so
            the number is set by whatever else is running, not by the display.

            Raise it if the panel feels slow and `heap` shows internal RAM to
            spare; lower it if allocation still fails. If it fails even at 4,
            the answer is not here: something else needs to stop using
            internal RAM.

    config MP4_ROBOT_SERVO_ENABLE
        bool "Drive the SPI servo boards"
        depends on MP4_ROBOT_ENABLE
        default y
        help
            Bring up the four AT32F413 driver boards on SPI3 and start the
            gait task.

            Turn this off for a board that runs the agent, the display and
            the voice stack but has no servo harness. driver_board_init()
            then reports "servos disabled in this build" and everything
            downstream degrades the way it already does when the boards do
            not answer: mpx_robot_ready() is false, robot tools return
            "robot not initialised", and selftest reports SKIP.

            This is not only about tidiness. SPI3 and the four chip-select
            lines (GPIO 15, 7, 4, 5 on the MP4 board) belong to other
            peripherals on other boards -- on Santy Control they are camera
            data lines -- so claiming them where there is no servo harness
            drives pins that belong to something else.

    config MP4_VOICE_ENABLE
        bool "Voice: wake word, echo cancellation and the cloud voice link"
        depends on MP4_ROBOT_ENABLE
        default y
        help
            Pull in esp-sr and run its acoustic front end (AEC + VAD +
            WakeNet, "Hi ESP") on the ES7210 microphones, plus the Opus /
            WebSocket link to the xiaozhi voice server.

            Cloud-as-brain (docs/voice-plan.md, option A): transcription
            and the reply both happen server-side. No on-device command
            recognition (MultiNet) is built.

    config MP4_VOICE_AUTO_LISTEN
        bool "Hands-free from boot: listen for the wake word, then converse"
        depends on MP4_VOICE_ENABLE
        default y
        help
            Start the hands-free loop at boot (mpx_voice_wake_auto_start()):
            listen for "Hi ESP", beep, stream what you say until the server
            decides you have finished, play the reply, listen again.

            The microphone is open continuously while this is on, so
            `voice talk` refuses to start; use `wake auto off` for the manual
            commands. The device still has to be provisioned once with
            `voice provision`.

    config MP4_VOICE_AUTO_MAX_SECONDS
        int "Hands-free: give up listening after this many seconds of nothing"
        depends on MP4_VOICE_ENABLE
        range 3 60
        default 12
        help
            In hands-free mode the server's VAD normally ends the listen. If
            it never does -- you said the wake word and then nothing, or the
            socket went quiet -- the microphone is released after this long
            and the wake word is listened for again.

            Depends on MP4_VOICE_ENABLE rather than MP4_VOICE_AUTO_LISTEN on
            purpose: `wake auto on` from the console works even when the
            boot default is off, and needs this value then too.

            The models live in the "model" partition, which exists only in
            partitions_16MB.csv. A board with less flash cannot hold them.

    config MP4_MCP_GROUPS
        string "Capability groups offered to the cloud voice model over MCP"
        depends on MP4_ROBOT_ENABLE
        default "cap_display cap_robot cap_mpx_skill"
        help
            Space-separated claw_cap group ids (see `mcp info` on the console
            for names and counts). Empty means every group the on-device
            agent can call -- about 60 tools, which is more than the cloud
            model copes with: the session that exposed everything is the
            one where it stopped calling tools at all.

            The default is the split that keeps voice snappy: only the
            quick, direct things (the screen, the robot's moves, the MPX
            skills -- a dozen tools) are offered as tools the cloud model
            calls itself. Everything else -- Lua, files, the scheduler,
            web search, system info -- it reaches through ask_robot_agent,
            which hands the request to the onboard ESP-Claw agent that has
            those capabilities AND knows how to use them. Fewer schemas per
            turn for xiaozhi's model; the heavy lifting on the robot's own
            agent. Add groups here (e.g. cap_lua cap_files cap_system
            cap_scheduler cap_web_search cap_http_request) to let the cloud
            model call them directly instead.

    config MP4_PI_LINK_ENABLE
        bool "Raspberry Pi UART link on the J-PI header"
        depends on MP4_ROBOT_ENABLE
        default y
        help
            Opens UART1 on the two J-PI header GPIOs below and registers the
            `pi` console command (`pi status` says CONNECTED / NOT CONNECTED).
            The Pi runs tools/pi/mp4_link.py. See tools/pi/README.md for the
            wiring and the Pi-side setup.

    config MP4_PI_LINK_TX_GPIO
        int "  ESP TX -> Pi RXD (GPIO15, header pin 10)"
        depends on MP4_PI_LINK_ENABLE
        range 0 48
        default 18
        help
            Default 18 = schematic net IO18_PI_1 on the J-PI header.
            GPIO3 (PI_3) is avoided: it is an ESP32-S3 strapping pin.

    config MP4_PI_LINK_RX_GPIO
        int "  ESP RX <- Pi TXD (GPIO14, header pin 8)"
        depends on MP4_PI_LINK_ENABLE
        range 0 48
        default 8
        help
            Default 8 = schematic net IO8_PI_2 on the J-PI header.

    config MP4_PI_LINK_BAUD
        int "  Baud rate"
        depends on MP4_PI_LINK_ENABLE
        default 115200
        help
            Must match --baud on the Pi side (mp4_link.py defaults to 115200).

    config MP4_GATEWAY_HOST
        string "Skill marketplace gateway host"
        depends on MP4_ROBOT_ENABLE
        default "35.220.215.160"
        help
            Host or IP of the skill marketplace gateway that the
            /v1/marketplace endpoints are proxied to.

            The default is the same gateway the mangdang firmware uses -- it
            reaches it through CONFIG_APP_CHAT_SERVER_IP, which is why the two
            builds behaved differently until this default was filled in.

            Leave empty (or set to "echo") to build a robot with no
            marketplace: those routes then answer 503 with "no marketplace
            gateway is configured on this robot", and the PWA's Store screen
            stays empty instead of hanging on a host that is not there.

            Note this is plain HTTP on port 8080, with no TLS -- inherited
            from the original firmware. Marketplace traffic, including
            whatever mpx-cli auth sends, is readable on the wire.

    config MP4_GATEWAY_PORT
        int "Skill marketplace gateway port"
        depends on MP4_ROBOT_ENABLE
        range 1 65535
        default 8080

    config MP4_SKILL_AES_KEY_HEX
        string "MPXE skill decryption key (64 hex chars)"
        depends on MP4_ROBOT_ENABLE
        default "0000000000000000000000000000000000000000000000000000000000000001"
        help
            AES-256 root key used to unwrap the per-skill key inside an .mpxe
            module. The default is INSECURE and is refused in release builds.

endmenu

endmenu
```
